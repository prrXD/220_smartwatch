#include "oled.h"
#include "i2c.h"
#include <stdio.h>
#include <stdarg.h>
#include <string.h>

/* ==================== Framebuffer ==================== */
uint8_t OLED_Buffer[SSD1306_WIDTH * SSD1306_PAGES];

/* ==================== 6x8 ASCII Font (95 chars) ==================== */
static const uint8_t OLED_F6x8[96][6] = {
    {0x00,0x00,0x00,0x00,0x00,0x00},{0x00,0x00,0x5F,0x00,0x00,0x00},
    {0x00,0x07,0x00,0x07,0x00,0x00},{0x14,0x7F,0x14,0x7F,0x14,0x00},
    {0x24,0x2A,0x7F,0x2A,0x12,0x00},{0x23,0x13,0x08,0x64,0x62,0x00},
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    {0x08,0x08,0x2A,0x1C,0x08,0x00},{0x08,0x1C,0x2A,0x08,0x08,0x00},
};

/* ==================== 8x16 Font (digits + uppercase + symbols) ==================== */
static const uint8_t OLED_F8x16[42][16] = {
    {0x00,0xE0,0x10,0x08,0x08,0x10,0xE0,0x00,0x00,0x0F,0x10,0x20,0x20,0x10,0x0F,0x00},
    {0x00,0x10,0x10,0xF8,0x00,0x00,0x00,0x00,0x00,0x20,0x20,0x3F,0x20,0x20,0x00,0x00},
    {0x00,0x70,0x08,0x08,0x08,0x88,0x70,0x00,0x00,0x30,0x28,0x24,0x22,0x21,0x30,0x00},
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    {0x00,0x00,0x00,0xFF,0x00,0x00,0x00,0x00,0x00,0x00,0x00,0x3F,0x20,0x20,0x00,0x00},
};

/* ==================== I2C Helper ==================== */

static void SSD1306_WriteCommand(uint8_t cmd) {
    HAL_I2C_Mem_Write(&hi2c1, SSD1306_ADDR << 1, 0x00, I2C_MEMADD_SIZE_8BIT, &cmd, 1, 100);
}

static void SSD1306_WriteCommands(const uint8_t *cmds, uint8_t len) {
    HAL_I2C_Mem_Write(&hi2c1, SSD1306_ADDR << 1, 0x00, I2C_MEMADD_SIZE_8BIT, (uint8_t *)cmds, len, 100);
}

static void SSD1306_WriteData(const uint8_t *data, uint16_t len) {
    HAL_I2C_Mem_Write(&hi2c1, SSD1306_ADDR << 1, 0x40, I2C_MEMADD_SIZE_8BIT, (uint8_t *)data, len, 200);
}

/* ==================== Initialization ==================== */

void OLED_Init(void) {
    /* Wait for SSD1306 power-up */
    HAL_Delay(100);

    /* Init sequence */
    uint8_t init[] = {
        0xAE,       /* Display OFF */
        0x20, 0x00, /* Horizontal addressing mode */
        0x40,       /* Display start line = 0 */
        0xA1,       /* Segment remap: col 127 = SEG0 */
        0xC8,       /* COM scan direction: COM[N-1] to COM0 */
        0xA8, 0x3F, /* Multiplex ratio: 63 (64 rows) */
        0xD3, 0x00, /* Display offset: 0 */
        0xD5, 0x80, /* Clock divide / oscillator frequency */
        0xD9, 0xF1, /* Pre-charge period */
        0xDA, 0x12, /* COM pins hardware config: alternative */
        0xDB, 0x40, /* VCOMH deselect level */
        0x81, 0xCF, /* Contrast: 207 */
        0x8D, 0x14, /* Charge pump enable */
        0xA4,       /* Entire display ON: follows RAM */
        0xA6,       /* Normal display (not inverted) */
        0x2E,       /* Deactivate scroll */
        0xAF        /* Display ON */
    };
    SSD1306_WriteCommands(init, sizeof(init));
    OLED_Clear();
}

void OLED_SetContrast(uint8_t contrast) {
    SSD1306_WriteCommand(0x81);
    SSD1306_WriteCommand(contrast);
}

void OLED_DisplayOn(void)  { SSD1306_WriteCommand(0xAF); }
void OLED_DisplayOff(void) { SSD1306_WriteCommand(0xAE); }
void OLED_InvertDisplay(uint8_t invert) {
    SSD1306_WriteCommand(invert ? 0xA7 : 0xA6);
}

/* ==================== Framebuffer Operations ==================== */

void OLED_Clear(void) {
    memset(OLED_Buffer, 0x00, sizeof(OLED_Buffer));
    OLED_Update();
}

void OLED_ClearBuffer(void) {
    memset(OLED_Buffer, 0x00, sizeof(OLED_Buffer));
}

void OLED_Update(void) {
    /* Page addressing mode for reliable transmission */
    for (uint8_t page = 0; page < SSD1306_PAGES; page++) {
        uint8_t cmds[] = {
            0xB0 | page,   /* Set page address */
            0x00,          /* Set lower column start (2 for some margin, use 0 normally) */
            0x10           /* Set higher column start */
        };
        SSD1306_WriteCommands(cmds, 3);
        SSD1306_WriteData(&OLED_Buffer[page * SSD1306_WIDTH], SSD1306_WIDTH);
    }
}

void OLED_UpdateArea(uint8_t start_page, uint8_t end_page) {
    for (uint8_t page = start_page; page <= end_page; page++) {
        uint8_t cmds[] = { 0xB0 | page, 0x00, 0x10 };
        SSD1306_WriteCommands(cmds, 3);
        SSD1306_WriteData(&OLED_Buffer[page * SSD1306_WIDTH], SSD1306_WIDTH);
    }
}

/* ==================== Drawing Primitives ==================== */

void OLED_SetPixel(uint8_t x, uint8_t y, uint8_t color) {
    if (x >= SSD1306_WIDTH || y >= SSD1306_HEIGHT) return;
    if (color)
        OLED_Buffer[x + (y / 8) * SSD1306_WIDTH] |= (1 << (y & 7));
    else
        OLED_Buffer[x + (y / 8) * SSD1306_WIDTH] &= ~(1 << (y & 7));
}

void OLED_DrawHLine(uint8_t x, uint8_t y, uint8_t w) {
    for (uint8_t i = 0; i < w; i++) OLED_SetPixel(x + i, y, 1);
}

void OLED_DrawVLine(uint8_t x, uint8_t y, uint8_t h) {
    for (uint8_t i = 0; i < h; i++) OLED_SetPixel(x, y + i, 1);
}

void OLED_DrawLine(uint8_t x0, uint8_t y0, uint8_t x1, uint8_t y1) {
    int16_t dx = (int16_t)x1 - x0;
    int16_t dy = (int16_t)y1 - y0;
    int16_t sx = dx > 0 ? 1 : -1;
    int16_t sy = dy > 0 ? 1 : -1;
    dx = dx > 0 ? dx : -dx;
    dy = dy > 0 ? dy : -dy;
    int16_t err = dx - dy;

    while (1) {
        OLED_SetPixel(x0, y0, 1);
        if (x0 == x1 && y0 == y1) break;
        int16_t e2 = 2 * err;
        if (e2 > -dy) { err -= dy; x0 += sx; }
        if (e2 < dx)  { err += dx; y0 += sy; }
    }
}

void OLED_DrawRect(uint8_t x, uint8_t y, uint8_t w, uint8_t h) {
    OLED_DrawHLine(x, y, w);
    OLED_DrawHLine(x, y + h - 1, w);
    OLED_DrawVLine(x, y, h);
    OLED_DrawVLine(x + w - 1, y, h);
}

void OLED_DrawFilledRect(uint8_t x, uint8_t y, uint8_t w, uint8_t h) {
    for (uint8_t i = 0; i < h; i++)
        OLED_DrawHLine(x, y + i, w);
}

void OLED_DrawCircle(uint8_t cx, uint8_t cy, uint8_t r) {
    int16_t x = 0, y = r;
    int16_t d = 3 - 2 * r;
    while (y >= x) {
        OLED_SetPixel(cx + x, cy + y, 1);
        OLED_SetPixel(cx - x, cy + y, 1);
        OLED_SetPixel(cx + x, cy - y, 1);
        OLED_SetPixel(cx - x, cy - y, 1);
        OLED_SetPixel(cx + y, cy + x, 1);
        OLED_SetPixel(cx - y, cy + x, 1);
        OLED_SetPixel(cx + y, cy - x, 1);
        OLED_SetPixel(cx - y, cy - x, 1);
        x++;
        if (d > 0) { y--; d += 4 * (x - y) + 10; }
        else        { d += 4 * x + 6; }
    }
}

void OLED_DrawFilledCircle(uint8_t cx, uint8_t cy, uint8_t r) {
    int16_t x = 0, y = r;
    int16_t d = 3 - 2 * r;
    while (y >= x) {
        OLED_DrawHLine(cx - x, cy - y, 2 * x + 1);
        OLED_DrawHLine(cx - x, cy + y, 2 * x + 1);
        OLED_DrawHLine(cx - y, cy - x, 2 * y + 1);
        OLED_DrawHLine(cx - y, cy + x, 2 * y + 1);
        x++;
        if (d > 0) { y--; d += 4 * (x - y) + 10; }
        else        { d += 4 * x + 6; }
    }
}

void OLED_DrawBitmap(uint8_t x, uint8_t y, const uint8_t *bitmap, uint8_t w, uint8_t h) {
    for (uint8_t j = 0; j < h; j++) {
        for (uint8_t i = 0; i < w; i++) {
            if (bitmap[i + (j / 8) * w] & (1 << (j & 7)))
                OLED_SetPixel(x + i, y + j, 1);
        }
    }
}

void OLED_ReverseArea(uint8_t x, uint8_t y, uint8_t w, uint8_t h) {
    for (uint8_t j = 0; j < h; j++) {
        for (uint8_t i = 0; i < w; i++) {
            uint8_t px = x + i;
            uint8_t py = y + j;
            if (px < SSD1306_WIDTH && py < SSD1306_HEIGHT) {
                uint8_t *byte = &OLED_Buffer[px + (py / 8) * SSD1306_WIDTH];
                uint8_t bit = 1 << (py & 7);
                *byte ^= bit;  /* toggle pixel */
            }
        }
    }
}

/* ==================== Text Rendering (6x8 font) ==================== */

void OLED_DrawChar6x8(uint8_t x, uint8_t page, char c) {
    if (page >= SSD1306_PAGES) return;
    if (c < 0x20 || c > 0x7E) c = ' ';

    const uint8_t *glyph = OLED_F6x8[(uint8_t)(c - 0x20)];
    for (uint8_t col = 0; col < 6; col++) {
        if (x + col < SSD1306_WIDTH)
            OLED_Buffer[x + col + page * SSD1306_WIDTH] = glyph[col];
    }
}

void OLED_DrawString6x8(uint8_t x, uint8_t page, const char *str) {
    while (*str) {
        OLED_DrawChar6x8(x, page, *str);
        x += 6;
        if (x + 6 > SSD1306_WIDTH) break;
        str++;
    }
}

/* ==================== Text Rendering (8x16 font) ==================== */

static uint8_t _char_index_8x16(char c) {
    if (c >= '0' && c <= '9') return c - '0';
    if (c == ':') return 10;
    if (c == '.') return 11;
    if (c == '-') return 12;
    if (c == '/') return 13;
    if (c == ' ') return 14;
    if (c >= 'A' && c <= 'Z') return 15 + (c - 'A');
    if (c >= 'a' && c <= 'z') return 15 + (c - 'a');
    return 14; /* default: space */
}

void OLED_DrawChar8x16(uint8_t x, uint8_t page, char c) {
    if (page + 1 >= SSD1306_PAGES) return;
    if (x + 8 > SSD1306_WIDTH) return;

    uint8_t idx = _char_index_8x16(c);
    const uint8_t *glyph = OLED_F8x16[idx];

    for (uint8_t col = 0; col < 8; col++) {
        OLED_Buffer[x + col + page * SSD1306_WIDTH] = glyph[col];
        OLED_Buffer[x + col + (page + 1) * SSD1306_WIDTH] = glyph[col + 8];
    }
}

void OLED_DrawString8x16(uint8_t x, uint8_t page, const char *str) {
    while (*str) {
        OLED_DrawChar8x16(x, page, *str);
        x += 8;
        if (x + 8 > SSD1306_WIDTH) break;
        str++;
    }
}

/* ==================== Large Number (16x24) Rendering ==================== */

void OLED_DrawDigit16x24(uint8_t x, uint8_t y, uint8_t digit) {
    if (digit > 9) return;
    if (x + 16 > SSD1306_WIDTH || y + 24 > SSD1306_HEIGHT) return;

    const uint8_t *glyph = Font16x24[digit];
    uint8_t start_page = y / 8;

    for (uint8_t page = 0; page < 3; page++) {
        if (start_page + page >= SSD1306_PAGES) break;
        for (uint8_t col = 0; col < 16; col++) {
            uint8_t offset = x + col + (start_page + page) * SSD1306_WIDTH;
            if (offset < sizeof(OLED_Buffer)) {
                uint8_t data = glyph[page * 16 + col];
                uint8_t bit_shift = y & 7;
                if (bit_shift) {
                    OLED_Buffer[offset] |= (data << bit_shift);
                    if (offset + SSD1306_WIDTH < sizeof(OLED_Buffer))
                        OLED_Buffer[offset + SSD1306_WIDTH] |= (data >> (8 - bit_shift));
                } else {
                    OLED_Buffer[offset] = data;
                }
            }
        }
    }
}

void OLED_DrawColon16x24(uint8_t x, uint8_t y) {
    if (x + 16 > SSD1306_WIDTH || y + 24 > SSD1306_HEIGHT) return;

    const uint8_t *glyph = Font16x24[10]; /* colon */
    uint8_t start_page = y / 8;

    for (uint8_t page = 0; page < 3; page++) {
        if (start_page + page >= SSD1306_PAGES) break;
        for (uint8_t col = 0; col < 16; col++) {
            uint8_t offset = x + col + (start_page + page) * SSD1306_WIDTH;
            if (offset < sizeof(OLED_Buffer)) {
                uint8_t data = glyph[page * 16 + col];
                uint8_t bit_shift = y & 7;
                if (bit_shift) {
                    OLED_Buffer[offset] |= (data << bit_shift);
                    if (offset + SSD1306_WIDTH < sizeof(OLED_Buffer))
                        OLED_Buffer[offset + SSD1306_WIDTH] |= (data >> (8 - bit_shift));
                } else {
                    OLED_Buffer[offset] = data;
                }
            }
        }
    }
}

void OLED_DrawTime16x24(uint8_t x, uint8_t y, uint8_t hour, uint8_t minute) {
    OLED_DrawDigit16x24(x,       y, hour / 10);
    OLED_DrawDigit16x24(x + 18,  y, hour % 10);
    OLED_DrawColon16x24(x + 36,  y);
    OLED_DrawDigit16x24(x + 54,  y, minute / 10);
    OLED_DrawDigit16x24(x + 72,  y, minute % 10);
}

/* ==================== printf-style output ==================== */

void OLED_Printf6x8(uint8_t x, uint8_t page, const char *fmt, ...) {
    char buf[32];
    va_list args;
    va_start(args, fmt);
    vsnprintf(buf, sizeof(buf), fmt, args);
    va_end(args);
    OLED_DrawString6x8(x, page, buf);
}

/* ==================== Chinese Character Rendering (16x16, GB2312) ==================== */

/**
  * @brief  Look up a Chinese character in OLED_CF16x16 by its GB2312 2-byte code.
  * @param  gb2312_code: pointer to 2-byte GB2312 code (e.g., "\xca\xb1" for 时)
  * @return pointer to ChineseCell_t, or NULL if not found
  */
static const ChineseCell_t* OLED_FindCN(const char *gb2312_code) {
    uint8_t count = OLED_CF16x16_Count;
    for (uint8_t i = 0; i < count; i++) {
        if (OLED_CF16x16[i].Index[0] == gb2312_code[0] &&
            OLED_CF16x16[i].Index[1] == gb2312_code[1]) {
            return &OLED_CF16x16[i];
        }
    }
    /* Return last entry as fallback (not-found glyph) */
    if (count > 0) return &OLED_CF16x16[count - 1];
    return 0;
}

/**
  * @brief  Draw a 16x16 Chinese character at (x, y).
  * @param  x: horizontal position (0-127)
  * @param  y: vertical position (0-63)
  * @param  gb2312_code: 2-byte GB2312 code string
  */
void OLED_DrawCNChar16(uint8_t x, uint8_t y, const char *gb2312_code) {
    if (x + 16 > SSD1306_WIDTH || y + 16 > SSD1306_HEIGHT) return;

    const ChineseCell_t *cell = OLED_FindCN(gb2312_code);
    if (!cell) return;

    const uint8_t *glyph = cell->Data;
    uint8_t start_page = y / 8;

    for (uint8_t page = 0; page < 2; page++) {
        if (start_page + page >= SSD1306_PAGES) break;
        for (uint8_t col = 0; col < 16; col++) {
            uint16_t offset = x + col + (start_page + page) * SSD1306_WIDTH;
            if (offset < sizeof(OLED_Buffer)) {
                uint8_t data = glyph[page * 16 + col];
                uint8_t bit_shift = y & 7;
                if (bit_shift) {
                    OLED_Buffer[offset] |= (data << bit_shift);
                    if (offset + SSD1306_WIDTH < sizeof(OLED_Buffer))
                        OLED_Buffer[offset + SSD1306_WIDTH] |= (data >> (8 - bit_shift));
                } else {
                    OLED_Buffer[offset] = data;
                }
            }
        }
    }
}

/**
  * @brief  Draw a string of GB2312-encoded Chinese characters.
  * @param  x: horizontal start position
  * @param  y: vertical start position
  * @param  gb2312_str: GB2312 encoded string (each char = 2 bytes)
  * @note   Each character is 16x16 pixels and advances x by 16.
  */
void OLED_DrawStringCN16(uint8_t x, uint8_t y, const char *gb2312_str) {
    while (*gb2312_str) {
        OLED_DrawCNChar16(x, y, gb2312_str);
        x += 16;
        if (x + 16 > SSD1306_WIDTH) break;
        gb2312_str += 2;  /* Each GB2312 char = 2 bytes */
    }
}